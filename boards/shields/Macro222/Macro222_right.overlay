#include "Macro222.dtsi" // The shared dtsi file is included in the overlay

// matrix transformでのピン数オフセット
&default_transform { // Offset of 2 because the left side has 2 columns
    col-offset = <2>;
};

// kscan
&kscan0 {
    col-gpios
        = <&xiao_d 4 GPIO_ACTIVE_HIGH>
        , <&xiao_d 5 GPIO_ACTIVE_HIGH>
        ;
};