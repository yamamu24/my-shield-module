## boards/shields/Kconfig.shield
```kconfig
#No whitespace after the comma or in your part name!
config SHIELD_MACRO222_LEFT
	def_bool $(shields_list_contains,Macro222_left)

config SHIELD_MACRO222_RIGHT
	def_bool $(shields_list_contains,Macro222_right)
```

## boards/shields/Macro222/Kconfig.defconfig
```kconfig
if SHIELD_MACRO222_RIGHT #ここを変えてセントラル側に問題のコードを移行

# Name must be less than 16 characters long!
config ZMK_KEYBOARD_NAME
    default "Macro222"

config ZMK_SPLIT_ROLE_CENTRAL
    default y

endif

if SHIELD_MACRO222_LEFT || SHIELD_MACRO222_RIGHT

config ZMK_SPLIT
    default y

endif
```
